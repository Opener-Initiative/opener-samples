## CMakeLists.txt
```
# Copyright (c) 2026 Codium Electronique
# SPDX-License-Identifier: Apache-2.0

cmake_minimum_required(VERSION 3.20.0)

find_package(Zephyr REQUIRED HINTS $ENV{ZEPHYR_BASE})
project(dectnrp)

target_sources(app PRIVATE
    src/dectnrp.c
    src/dectnrp_operation.c
    src/dectnrp_mac_helper.c
    src/main.c
)
```

## Kconfig
```
# Copyright (c) 2026 Codium Electronique
# SPDX-License-Identifier: Apache-2.0

module = SAMPLE_DRIVER_DECTNRP
module-str = Opener DECT NR+ driver sample
source "$(ZEPHYR_BASE)/subsys/logging/Kconfig.template.log_config"

menu "Zephyr Kernel"
source "Kconfig.zephyr"
endmenu

config DECTNRP_SAMPLE_NETWORK_ID
	hex "DECTNRP Network ID"
	default 0x32545279
	range 0x0 0xffffffff
	help
	  The default Network ID of the network this radio device should belong to.
	  When NET_CONFIG_DECTNRP_NETWORK_ID==0x0 is configured then no Network ID is choosen 
	  per default.

config DECTNRP_SAMPLE_LONG_DEVICE_ID
	hex "Long device address"
	default 0x55667788
	range 0x1 0xfffffffd
	help
	  Long device id of device 1.

config DECTNRP_SAMPLE_LONG_ADDR
	hex "DECTNRP Network ID"
	default 0x32545279
	range 0x0 0xffffffff
	help
	  The default Network ID of the network this radio device should belong to.
	  When NET_CONFIG_DECTNRP_NETWORK_ID==0x0 is configured then no Network ID is choosen 
	  per default.


config DECTNRP_SAMPLE_CHANNEL
	int "DECTNRP sample default channel"
	default 1677
	help
	  The channel to use by default in the sample application. 1677 is last channel of band 1.

config DECTNRP_SAMPLE_PERIOD
	int "RX period"
	default 5000
	help
	   The length of the receive window time in milliseconds.
```

## sample.yaml
```
sample:
  name: dectnrp
  description: Demo of the dectnrp driver
tests:
  sample.driver_api:
    platform_allow:
      - nrf9151dk/nrf9151/ns
      - cod_nrp_gw/nrf9151/ns
      - cod_nrp_node/nrf9151/ns
```

## prj.conf
```kconfig
# Copyright (c) 2026 Codium Electronique
# Copyright (c) 2026 Deveritec GmbH
# SPDX-License-Identifier: Apache-2.0

CONFIG_KERNEL_BIN_NAME="sample-dectnrp-driver"
CONFIG_NCS_APPLICATION_BOOT_BANNER_STRING="sample-dectnrp-driver"

#Enable thread awareness for debugging tools supporting it
CONFIG_DEBUG_THREAD_INFO=y
# Build with debug optimizations (-Og) for easier debugging
CONFIG_DEBUG_OPTIMIZATIONS=y
CONFIG_ASSERT=y

CONFIG_NETWORKING=y
CONFIG_NET_L2_DUMMY=y

# Kernel options
CONFIG_HEAP_MEM_POOL_SIZE=2048

CONFIG_HWINFO=y
CONFIG_LOG=y
CONFIG_USE_SEGGER_RTT=y
CONFIG_LOG_BACKEND_RTT=y
CONFIG_SEGGER_RTT_BUFFER_SIZE_UP=4096
CONFIG_LOG_BACKEND_RTT_MODE_OVERWRITE=y

CONFIG_DECTNRP_DRIVER_SCHEDULED_API=y
CONFIG_DECTNRP_DRIVER_BLOCKING_API=n

CONFIG_SAMPLE_DRIVER_DECTNRP_LOG_LEVEL_DBG=n
CONFIG_SAMPLE_DRIVER_DECTNRP_LOG_LEVEL_INF=y
CONFIG_DECTNRP_SAMPLE_NETWORK_ID=0x32545279
CONFIG_DECTNRP_SAMPLE_CHANNEL=1677
CONFIG_DECTNRP_SAMPLE_PERIOD=3000
```

## socs/nrf9151_ns.conf
```kconfig
# Copyright (c) 2026 Codium Electronique
# Copyright (c) 2026 Deveritec GmbH
# SPDX-License-Identifier: Apache-2.0

# Settings for all nRF9151 boards (non-secure): modem library with the
# DECT NR+ PHY firmware and the nRF91x1 driver.

CONFIG_NRF_MODEM_LIB=y
CONFIG_NRF_MODEM_LINK_BINARY_DECT_PHY=y
# Required by the nRF91x1 driver (depends on !MODEM_ANTENNA); enabled by
# default on some Nordic kits (e.g., nrf9151dk)
CONFIG_MODEM_ANTENNA=n

CONFIG_DECTNRP_DRIVER_NRF91X1=y
CONFIG_DECTNRP_DRIVER_NRF91X1_CAP_LOGGING=n

CONFIG_TFM_PROFILE_TYPE_MINIMAL=y
```

## boards/cod_nrp_node_nrf9151_ns.overlay
```dts
#include "nrf91x1_partition_without_bootloader.dtsi"
#include "nrf91x1_dect_modem.dtsi"
```

## boards/nrf9151dk_nrf9151_ns.overlay
```dts
#include "nrf91x1_dect_modem.dtsi"
```

## src/main.c
```c
/*
 * Copyright (c) 2026 Codium Electronique
 * Copyright (c) 2026 Deveritec GmbH
 * SPDX-License-Identifier: Apache-2.0
 */

#include <zephyr/logging/log.h>
LOG_MODULE_REGISTER(dectnrp_driver_sample, CONFIG_SAMPLE_DRIVER_DECTNRP_LOG_LEVEL);

#include "dectnrp_driver_utils.h"
#include "dectnrp_mac_helper.h"
#include "dectnrp_operation.h"
#include <opener/build_info.h>
#include <zephyr/drivers/hwinfo.h>
#include <zephyr/kernel.h>
#include <zephyr/net/dectnrp_driver.h>
#include <zephyr/net/dectnrp_net_l2.h>
#include <zephyr/net/net_if.h>
#include <zephyr/random/random.h>

#define MS_PER_FRAME 10
#define TIME_2_MODEMTICKS(TIME_MS)                                                                 \
	(DECTNRP_MODEMTICKS_PER_SYMBOL * DECTNRP_SYMBOLS_PER_FRAME * TIME_MS / MS_PER_FRAME)

extern struct k_fifo dectnrp_event_fifo;

static uint32_t network_id = CONFIG_DECTNRP_SAMPLE_NETWORK_ID;

enum state {
	DEVICE_STATE_UNSYNCHRONIZED,
	DEVICE_STATE_SYNCHRONIZING,
	DEVICE_STATE_SYNCHRONIZED,
	DEVICE_STATE_DESYNCHRONIZING,
};

static struct local_device {
	enum state state;
	uint32_t long_device_id;
	uint16_t short_device_id;
} local_device;

static struct remote_device {
	uint16_t short_device_id;
	net_time_t last_start_time;
} remote_device;

struct dectnrp_event_wrapper {
	void *fifo_reserved; /* 1st word reserved for use by FIFO */
	/** Event issued by dectnrp-driver. */
	struct dectnrp_driver_event event;
	/** Packet reference to received packet containing PCC and PDC.
	   Only used/valid if event->code == DECTNRP_EVENT_MSG_RECEIVED. */
	struct net_pkt *pkt;
};

/**
 * @brief Iterates over \p rssi1 and prints rssi1 results.
 *
 * @param result
 */
static void print_dbm(struct dectnrp_rssi1_result *result)
{
	uint8_t buffer[256];
	uint8_t *current = &buffer[0];
	size_t remaining = sizeof(buffer);

	size_t written = snprintf(current, remaining, "subslots[dBm]:[");
	if (written > 0 || (written < remaining)) {
		remaining -= written;
		current += written;
	}

	size_t size = sizeof(result->subslot);
	for (uint32_t subslot = 0; subslot < size; subslot++) {
		int16_t subslot_dbm = (int16_t)((0xff00 | result->subslot[subslot]));
		char comma = (subslot < size - 1) ? ',' : ' ';

		written = snprintf(current, remaining, "%d%c", subslot_dbm, comma);
		if (written > 0 || (written < remaining)) {
			remaining -= written;
			current += written;
		}
		if (remaining < 2) {
			break;
		}
	}

	remaining -= snprintf(current, remaining, "]");
	if (written > 0 || (written < remaining)) {
		remaining -= written;
		current += written;
	}

	LOG_INF("RSSI1 scan on carrier:%u", result->channel);
	LOG_INF("%s", buffer);
}

/**
 * @brief Does a blocking RSSI1 operation.
 *
 *  * Allocates and creates a rx-operation
 *  * Schedules it imediately via dectnrp_driver
 *  * Wait for the results and print them
 *
 * @param iface
 * @param duration_ms Length of the rssi1 operation in frames.
 */
static void rssi1_scan(struct net_if *iface, uint8_t frames)
{

	__ASSERT(iface != NULL, "iface == NULL");

	struct dectnrp_rssi1_result result;
	struct dectnrp_driver_op *op = NULL;
	const uint32_t subslots = frames * DECTNRP_SUBSLOTS_PER_FRAME;
	int ret = dectnrp_alloc_rssi1_operation(&op, iface, CONFIG_DECTNRP_SAMPLE_CHANNEL, 0,
						subslots, &result);
	if (ret != 0) {
		LOG_ERR("dectnrp_alloc_rssi1_operation failed, %d", ret);
	} else {

		ret = dectnrp_driver_schedule(iface, op);
		if (ret != 0) {
			LOG_ERR("dectnrp_driver_schedule(rssi1) failed, %d", ret);
			dectnrp_free_operation(op);
		} else {
			bool rssi1_finished = false;
			while (!rssi1_finished && (ret == 0)) {

				uint32_t timeout = 5 * (MS_PER_FRAME * frames);
				struct dectnrp_event_wrapper *item =
					k_fifo_get(&dectnrp_event_fifo, K_MSEC(timeout));

				struct dectnrp_driver_event *event = &item->event;

				if (event->code == DECTNRP_EVENT_OP_FINISHED) {
					__ASSERT(event->op_finished.op != NULL,
						 "event->op_finished.op == NULL");
					__ASSERT(op == event->op_finished.op,
						 "op != event->op_finished.op");
					__ASSERT(op->rssi1.result != NULL,
						 "op->rssi1.result == NULL");

					if (event->op_finished.op->status == 0) {
						print_dbm(op->rssi1.result);
					} else {
						LOG_ERR("RSSI1-scan failed,%d",
							event->op_finished.op->status);
					}

					dectnrp_free_operation(event->op_finished.op);
					rssi1_finished = true;
				} else {
					LOG_ERR("event->code=%u", event->code);
				}

				k_free(item);
			}
		}
	}
}

/**
 * @brief Allocates and creates a rx-operation and schedules it imediately via
 * dectnrp_driver.
 *
 * @param iface
 * @param duration_ms Length of the rx operation in modem ticks.
 * @return int
 */
static int receive(struct net_if *iface, uint32_t duration_ms, bool *received)
{

	__ASSERT(iface != NULL, "iface == NULL");
	__ASSERT(received != NULL, "received == NULL");

	*received = false;
	struct dectnrp_driver_op *op = NULL;
	int ret = dectnrp_alloc_rx_operation(&op, iface, CONFIG_DECTNRP_SAMPLE_CHANNEL);
	if (ret != 0) {
		LOG_ERR("dectnrp_alloc_rx_operation failed, %d", ret);
	} else {

		op->rx.duration = TIME_2_MODEMTICKS(duration_ms);

		LOG_INF("receive ...");

		ret = dectnrp_driver_schedule(iface, op);
		if (ret != 0) {
			LOG_ERR("dectnrp_driver_schedule(rx) failed, %d", ret);
			dectnrp_free_operation(op);
		} else {
			bool rx_finished = false;
			bool rx = false;
			while (!rx_finished && (ret == 0)) {

				uint32_t timeout = duration_ms + duration_ms / 2;
				struct dectnrp_event_wrapper *item =
					k_fifo_get(&dectnrp_event_fifo, K_MSEC(timeout));
				if (item == NULL) {
					LOG_ERR("receive event(s) missing");
					dectnrp_free_operation(op);
					op = NULL;
					ret = -EIO;
				} else {

					struct dectnrp_driver_event *event = &item->event;

					if (event->code == DECTNRP_EVENT_MSG_RECEIVED) {

						__ASSERT(item->pkt != NULL, "item->pkt == NULL");

						uint8_t pcc_len =
							event->msg_received.phy_type == 0
								? DECTNRP_PHY_HEADER_TYPE1_SIZE
								: DECTNRP_PHY_HEADER_TYPE2_SIZE;
						uint32_t pdc_len = event->msg_received.pdc_len;

						/* We just use a simple short cut and read pcc and
						 * pdc directly out of the packet. */
						uint8_t *pcc = net_pkt_data(item->pkt);
						uint8_t *pdc = &pcc[pcc_len];
						remote_device.short_device_id =
							pcc_decode_transmitter_short_id(pcc,
											pcc_len);
						remote_device.last_start_time =
							event->msg_received.start_time;
						rx = true;

						// LOG_INF("RX:");
						LOG_HEXDUMP_INF(pcc, pcc_len, "RX:PCC:");
						LOG_HEXDUMP_INF(pdc, pdc_len, "PDC:");

						net_pkt_unref(item->pkt);

					} else if (event->code == DECTNRP_EVENT_OP_FINISHED) {
						__ASSERT(event->op_finished.op != NULL,
							 "event->op_finished.op == NULL");
						__ASSERT(op == event->op_finished.op,
							 "op != event->op_finished.op");
						dectnrp_free_operation(event->op_finished.op);
						LOG_INF("receive complete");
						rx_finished = true;
						*received = rx;

					} else if (event->code == DECTNRP_EVENT_MSG_ERROR) {
						LOG_ERR("MSG_ERROR:0x%x",
							event->message_error.status);
					} else {
						LOG_ERR("event->code=%u", event->code);
					}

					k_free(item);
				}
			}
		}
	}

	return ret;
}

/**
 * @brief Allocates and creates a net_pkt from given data and its parameters and
 * transmits it via dectnrp_driver.
 *
 * @param iface
 * @param data
 * @param size
 * @param parameters
 * @return int
 */
static int transmit(struct net_if *iface, const uint8_t *data, size_t size, uint8_t phy_header_type,
		    const struct dectnrp_transport_parameters *parameters, net_time_t start_time)
{

	__ASSERT(iface != NULL, "iface == NULL");
	__ASSERT(data != NULL, "data == NULL");
	__ASSERT(parameters != NULL, "parameters == NULL");
	int ret = 0;

	struct net_pkt *pkt =
		net_pkt_alloc_with_buffer(iface, DECTNRP_MTU, AF_PACKET, IPPROTO_RAW, K_MSEC(50));
	if (!pkt) {
		LOG_ERR("Could not allocate pkt");
		ret = -ENOMEM;
	} else {

		struct dectnrp_driver_op *op = NULL;
		int ret =
			dectnrp_alloc_tx_operation(&op, iface, CONFIG_DECTNRP_SAMPLE_CHANNEL, pkt);
		if (ret != 0) {
			LOG_ERR("dectnrp_alloc_tx_operation failed, %d", ret);
			net_pkt_unref(pkt);
		} else {

			struct net_buf *frame_buf = pkt->frags;
			net_buf_add_mem(frame_buf, data, size);

			op->tx.transport_parameters = *parameters;
			op->tx.phy_header_type = phy_header_type;
			op->start_time = start_time;

			LOG_INF("transmit");

			ret = dectnrp_driver_schedule(iface, op);
			if (ret != 0) {
				LOG_ERR("dectnrp_driver_schedule(tx) failed, %d", ret);
			} else {
				/* Block unitil tx operation has been completed. */
				struct dectnrp_event_wrapper *item =
					k_fifo_get(&dectnrp_event_fifo, K_MSEC(10));
				if (item == NULL) {
					LOG_ERR("transmit complete event missing");
					dectnrp_free_operation(op);
					op = NULL;
					ret = -EIO;
				} else {
					struct dectnrp_driver_event *event = &item->event;
					__ASSERT(event->code == DECTNRP_EVENT_OP_FINISHED,
						 "unexpected event");
					__ASSERT(event->op_finished.op == op,
						 "event->op_finished.op != op");
					LOG_INF("transmit complete");

					k_free(item);
				}
			}
			dectnrp_free_operation(op);
		}
	}
	return ret;
}

int main()
{
	LOG_DBG("Opener version %d.%d.%d-%s%c", OPENER_VERSION_MAJOR, OPENER_VERSION_MINOR,
		OPENER_PATCHLEVEL, STRINGIFY(OPENER_GIT_COMMIT), OPENER_DIRTY ? '+' : '=');

	LOG_DBG("Opener dectnrp driver sample started");

	/* Get the DECT network interface */
	struct net_if *iface = net_if_get_first_by_type(&NET_L2_GET_NAME(DECTNRP));
	if (!iface) {
		LOG_ERR("net_if_get_first_by_type failed");
		return -ENODEV;
	} else if (!net_if_is_up(iface)) {
		LOG_ERR("net_if_is_up failed");
		return -ENOENT;

	} else {

		k_sleep(K_MSEC(1000));

		/* Assign our network id to the dectnrp_driver. */
		int ret = dectnrp_driver_set_network_id(iface, network_id);
		if (ret != 0) {
			LOG_ERR("dectnrp_driver_set_network_id failed, %d", ret);
			return -EIO;
		}

		/* Assign local long device id from hardware/chip id. */
		local_device.long_device_id = 0;
		size_t status = hwinfo_get_device_id((uint8_t *)&local_device.long_device_id,
						     sizeof(local_device.long_device_id));
		if (status != sizeof(local_device.long_device_id)) {
			LOG_ERR("hwinfo_get_device_id failed,%u", ret);
			/* If long id is not assigned from chip we fall back to default long id.
			 */
			local_device.long_device_id = CONFIG_DECTNRP_SAMPLE_LONG_DEVICE_ID;
		}
		/* Assign random short device id. */
		local_device.short_device_id = sys_rand32_get();
		local_device.state = DEVICE_STATE_UNSYNCHRONIZED;
		/* Remote peer not known yet.*/
		remote_device.short_device_id = DECTNRP_SHORT_BROADCAST_ADDRESS;

		LOG_INF("-------------------------");
		LOG_INF("Local device:");
		LOG_INF(" DEVICE_STATE_UNSYNCHRONIZED");
		LOG_INF(" - network id 0x%x", network_id);
		LOG_INF(" - long device id 0x%x", local_device.long_device_id);
		LOG_INF(" - short device id 0x%x", local_device.short_device_id);
		LOG_INF(" - channel %u", CONFIG_DECTNRP_SAMPLE_CHANNEL);
		LOG_INF("-------------------------");

		/* In unsynchronized mode we start with the full period. */
		uint32_t period = CONFIG_DECTNRP_SAMPLE_PERIOD;
		/* In unsynchronized mode we start with imediate messages the full period.
		 */
		net_time_t tx_start_time = 0;

		/* Read current network/modem-time from driver. */
		net_time_t net_time = 0;
		ret = dectnrp_driver_get_time(iface, &net_time);
		if (ret != 0) {
			LOG_ERR("Error while reading network time from driver,%d", ret);
		} else {
			LOG_INF("Network time=%" PRIu64 "", net_time);
		}

		/* Do a RSSI1 scan for a full frame. */
		const uint8_t frames = 1;
		rssi1_scan(iface, frames);

		/* Do periodically receive and send sample_frame via dectnrp_driver. */
		do {
			bool received = false;
			ret = receive(iface, period, &received);
			if (ret != 0) {
				LOG_ERR("receive failed, %d", ret);
				if (local_device.state != DEVICE_STATE_UNSYNCHRONIZED) {
					local_device.state = DEVICE_STATE_DESYNCHRONIZING;
				}
				/* If receive failed we idle for a full period. */
				k_sleep(K_MSEC(period));
			} else if (received) {
				if (local_device.state != DEVICE_STATE_SYNCHRONIZED) {
					local_device.state = DEVICE_STATE_SYNCHRONIZING;
				}
				k_sleep(K_MSEC(period / 2));
			} else if (!received) {
				if (local_device.state != DEVICE_STATE_UNSYNCHRONIZED) {
					local_device.state = DEVICE_STATE_DESYNCHRONIZING;
				}
			}

			switch (local_device.state) {
			case DEVICE_STATE_SYNCHRONIZING:
				/* We have received a packet.
				   Now we know our remote peer and its timing to which we can
				   synchronize. */
				local_device.state = DEVICE_STATE_SYNCHRONIZED;

				LOG_INF("-------------------------");
				LOG_INF("Local device:");
				LOG_INF(" DEVICE_STATE_SYNCHRONIZED");
				LOG_INF("Remote device:");
				LOG_INF(" - short device id 0x%x", remote_device.short_device_id);
				LOG_INF("-------------------------");

				__attribute__((fallthrough));
			case DEVICE_STATE_SYNCHRONIZED:
				/* Update the time of our next packet to be sent.
				   In synchornized mode we have a dedicated start time when to send.
				 */
				tx_start_time = remote_device.last_start_time +
						TIME_2_MODEMTICKS(period / 2);
				break;
			case DEVICE_STATE_DESYNCHRONIZING:
				/* We have not received a packet (or reception failed).
				   We go back to unsynchronized mode.
				   Remote peer not known anymore.*/
				remote_device.short_device_id = DECTNRP_SHORT_BROADCAST_ADDRESS;
				local_device.state = DEVICE_STATE_UNSYNCHRONIZED;

				LOG_INF("DEVICE_STATE_UNSYNCHRONIZED");

				__attribute__((fallthrough));
			case DEVICE_STATE_UNSYNCHRONIZED:
				/* In unsynchronized mode we send imediately. */
				tx_start_time = 0;
				break;
			}

			/* Update tx packet. */
			uint8_t *pcc = &sample_frame[0];
			pcc_set_short_network_id(pcc, network_id);
			pcc_set_transmitter_short_id(pcc, local_device.short_device_id);
			pcc_set_receiver_short_id(pcc, remote_device.short_device_id);

			ret = transmit(iface, &sample_frame[0], sample_frame_size,
				       sample_frame_phy_header_type, &sample_frame_parameters,
				       tx_start_time);
			if (ret != 0) {
				LOG_ERR("transmit failed, %d", ret);
			}

		} while (true);
	}

	return 0;
}
```

## src/dectnrp.c
```c
/*
 * Copyright (c) 2026 Deveritec GmbH
 * SPDX-License-Identifier: Apache-2.0
 */

/**
 * @file
 * @brief DECTNRP This contains first rudimentary implementation of l2/decnrp.
 *
 */

#include <zephyr/logging/log.h>
LOG_MODULE_REGISTER(dectnrp, CONFIG_SAMPLE_DRIVER_DECTNRP_LOG_LEVEL);

#include <zephyr/net/dectnrp_driver.h>
#include <zephyr/net/net_if.h>
#include <zephyr/net/net_log.h>
#include "dectnrp_driver_utils.h"
#include "dectnrp_operation.h"

/* event fifo queue. */
struct k_fifo dectnrp_event_fifo;

struct dectnrp_event_wrapper {
	void *fifo_reserved; /* 1st word reserved for use by FIFO */
	/** Event issued by dectnrp-driver. */
	struct dectnrp_driver_event event;
	/** Packet reference to received packet containing PCC and PDC.
	   Only used/valid if event->code == DECTNRP_EVENT_MSG_RECEIVED. */
	struct net_pkt *pkt;
};

/**
 * @brief Callback event handler for dectnrp driver events.
 *
 * @attention This function may run in interrupt context!
 *
 * @param iface
 * @param event
 */
static void dectnrp_driver_event(struct net_if *iface, const struct dectnrp_driver_event *event)
{
	__ASSERT(event != NULL, "event == NULL");

	struct net_pkt *pkt = NULL;

	switch (event->code) {
	case DECTNRP_EVENT_MSG_ERROR:
	case DECTNRP_EVENT_MSG_RECEIVED:
	case DECTNRP_EVENT_OP_FINISHED:
	case DECTNRP_EVENT_OP_RESULTS: {

		if (event->code == DECTNRP_EVENT_MSG_ERROR) {
			NET_DBG("DECTNRP_EVENT_MSG_ERROR");
		} else if (event->code == DECTNRP_EVENT_MSG_RECEIVED) {
			NET_DBG("DECTNRP_EVENT_MSG_RECEIVED");

			/* We need to copy received message (pcc + pdc) as the driver 'owns'
			 the memory and may re-use it after this event callback. */
			__ASSERT(event->msg_received.pcc != NULL,
				 "event->msg_received.pcc == NULL");
			__ASSERT(event->msg_received.pdc != NULL,
				 "event->msg_received.pdc == NULL");

			uint8_t pcc_len = event->msg_received.phy_type == 0
						  ? DECTNRP_PHY_HEADER_TYPE1_SIZE
						  : DECTNRP_PHY_HEADER_TYPE2_SIZE;
			uint32_t packet_len = pcc_len + event->msg_received.pdc_len;

			pkt = net_pkt_alloc_with_buffer(iface, packet_len, AF_PACKET, IPPROTO_RAW,
							K_MSEC(10));
			if (!pkt) {
				LOG_ERR("Failed to allocate rx pkt of length %d,drop data",
					packet_len);
				/* FIXME what to do in that case? */
				return;
			}

			int ret = net_pkt_write(pkt, event->msg_received.pcc, pcc_len);
			if (ret < 0) {
				LOG_ERR("net_pkt_write(pcc) failed,%d,drop data", ret);
				net_pkt_unref(pkt);
				return;
			}
			ret = net_pkt_write(pkt, event->msg_received.pdc,
					    event->msg_received.pdc_len);
			if (ret < 0) {
				LOG_ERR("net_pkt_write(pdc) failed,%d,drop data", ret);
				net_pkt_unref(pkt);
				return;
			}

		} else if (event->code == DECTNRP_EVENT_OP_FINISHED) {
			NET_DBG("DECTNRP_EVENT_OP_FINISHED");
		} else if (event->code == DECTNRP_EVENT_OP_RESULTS) {
			NET_DBG("DECTNRP_EVENT_OP_RESULTS");
		} else {
			NET_DBG("code=%u", event->code);
		}

		struct dectnrp_event_wrapper *item = k_malloc(sizeof(struct dectnrp_event_wrapper));
		__ASSERT(item != NULL, "fifo_item == NULL");

		memcpy(&item->event, event, sizeof(struct dectnrp_driver_event));

		if (event->code == DECTNRP_EVENT_MSG_RECEIVED) {
			item->pkt = pkt;
			/** Invalidate original message pointers. */
			item->event.msg_received.pcc = NULL;
			item->event.msg_received.pdc = NULL;
		}

		k_fifo_put(&dectnrp_event_fifo, (void *)item);

		break;
	}
	default: {
		NET_WARN("unknown driver event, not handled, %u", event->code);
		break;
	}
	}
}

/**
 * @brief Function called by net framework when a rx-packet has to be handled by
 * l2 layer.
 *
 * @param iface
 * @param pkt
 * @return enum net_verdict
 */
static enum net_verdict dectnrp_recv(struct net_if *iface, struct net_pkt *pkt)
{
	LOG_DBG("dectnrp_recv(%p)", iface);
	return NET_DROP;
}

/**
 * @brief Function called by net framework when a tx-packet has to be handled by
 * l2 layer.
 *
 * @param iface
 * @param pkt
 * @return int
 */
static int dectnrp_send(struct net_if *iface, struct net_pkt *pkt)
{
	LOG_DBG("dectnrp_send(%p)", iface);
	return -EIO;
}

/**
 * @brief Function called by net framework when @p iface should be
 * enabled/disabled.
 *
 * @param iface
 * @param state
 * @return int
 */
static int dectnrp_enable(struct net_if *iface, bool state)
{
	NET_DBG("iface %p %s", iface, state ? "up" : "down");

	int ret = 0;
	if (state) {
		ret = dectnrp_driver_start(iface);
		if (ret != 0) {
			ret = dectnrp_driver_stop(iface);
		}
	}

	// at notify_iface_up() in we need a valid link address
	// deps/zephyr/subsys/net/ip/net_if.c:5837
	uint8_t link_addr[] = {0x01, 0x02, 0x03, 0x04, 0x05, 0x06, 0x07, 0x08};
	net_if_set_link_addr(iface, link_addr, NET_LINK_ADDR_MAX_LENGTH, NET_LINK_DUMMY);

	return ret;
}

/**
 * @brief Function called by net framework when l2 flags are needed.
 *
 * @param iface
 * @return enum net_l2_flags
 */
static enum net_l2_flags dectnrp_flags(struct net_if *iface)
{
	LOG_DBG("dectnrp_flags(%p)", iface);
	struct dectnrp_context *ctx = net_if_l2_data(iface);
	/* No need for locking as these flags as they are set once
	 * during L2 initialization and then never changed.
	 */
	return ctx->flags;
}

NET_L2_INIT(DECTNRP_L2, dectnrp_recv, dectnrp_send, dectnrp_enable, dectnrp_flags);

/**
 * @brief dectnrp_stack initialization callback.
 *
 * This is the init callback which gets called from nrf91x1_net_if_init.
 * As we have no dectnrp l2 yet we implement it here.
 *
 * @param iface
 */
void dectnrp_l2_init(struct net_if *iface)
{
	struct dectnrp_context *ctx = net_if_l2_data(iface);
	LOG_DBG("dectnrp_l2_init(%p)", iface);

	ctx->flags = NET_L2_MULTICAST;
	if (dectnrp_driver_get_hw_capabilities(iface) && DECTNRP_HW_PROMISC) {
		ctx->flags |= NET_L2_PROMISC_MODE;
	}
	ctx->iface = iface;

	k_fifo_init(&dectnrp_event_fifo);

	dectnrp_driver_register_event_handler(iface, dectnrp_driver_event);

	LOG_DBG("L2 interface initialized");
	return;
}
```

## src/dectnrp_driver_utils.h
```c
/*
 * Copyright (c) 2026 Deveritec GmbH
 * SPDX-License-Identifier: Apache-2.0
 */

/**
 * @file
 * @brief dectnrp low level driver helper utilities
 *
 * @note References are to the ETSI TS 103 636 DECTNRP NR+ V2.2.1 (2026-05)
 * standard If not further noted all references in this file refer to ETSI TS
 * 103 636-4.
 */

#ifndef __DECTNRP_DRIVER_UTILS_H__
#define __DECTNRP_DRIVER_UTILS_H__

#include <zephyr/net/dectnrp_driver.h>

/**
 * @brief Read hardware capabilities from dectnrp_driver related to given @p
 * iface.
 *
 * @param iface
 * @return enum dectnrp_hw_caps
 */
static inline int dectnrp_driver_get_hw_capabilities(struct net_if *iface) {
  const struct dectnrp_driver_api *driver = net_if_get_device(iface)->api;
  if (!driver) {
    return 0;
  } else if (driver->get_hw_capabilities == NULL) {
    return 0;
  } else {
    return driver->get_hw_capabilities(net_if_get_device(iface));
  }
}

/**
 * @brief Read capabilities from dectnrp_driver related to given @p iface.
 *
 * @param iface
 * @param[out] caps
 * @return int
 * @retval 0 success
 * @retval -ENOENT driver interface not ready
 * @retval -ENOTSUP function not supported by driver
 */
static inline int
dectnrp_driver_get_capabilities(struct net_if *iface,
                                struct dectnrp_device_capabilities *caps) {
  const struct dectnrp_driver_api *driver = net_if_get_device(iface)->api;
  if (!driver) {
    return -ENOENT;
  } else if (driver->get_capabilities == NULL) {
    return -ENOTSUP;
  } else {
    return driver->get_capabilities(net_if_get_device(iface), caps);
    return 0;
  }
}

/**
 * @brief Set the network id @p network_id used by the dectnrp_driver related to
 * given @p iface.
 *
 * @param iface
 * @param network_id Network id set for descrambling/scrambling of packets.
 * @return int
 * @retval 0 success
 * @retval -ENOENT driver interface not ready
 * @retval -ENOTSUP function not supported by driver
 */
static inline int dectnrp_driver_set_network_id(struct net_if *iface,
                                                uint32_t network_id) {

  const struct dectnrp_driver_api *driver = net_if_get_device(iface)->api;
  if (!driver) {
    return -ENOENT;
  } else if (driver->configure == NULL) {
    return -ENOTSUP;
  } else {
    return driver->configure(
        net_if_get_device(iface), DECTNRP_CONFIG_TYPE_NETWORK_ID,
        &(const struct dectnrp_config){.network_id = network_id});
  }
}

/**
 * @brief Get current modem time stamp from dectnrp_driver
 * related to given @p iface.
 *
 * @attention The returned @p time may a several ticks in the past!
 *
 * @param iface
 * @param time
 * @return int
 * @retval 0 success
 * @retval -ENOENT driver interface not ready
 * @retval -ENOTSUP function not supported by driver
 */
static inline int dectnrp_driver_get_time(struct net_if *iface,
                                          net_time_t *time) {
  const struct dectnrp_driver_api *driver = net_if_get_device(iface)->api;

  if (!driver) {
    return -ENOENT;
  } else if (driver->get_time == NULL) {
    return -ENOTSUP;
  } else {
    return driver->get_time(net_if_get_device(iface), time);
  }
}

/**
 * @brief Schedule given driver operation @p op at the dectnrp_driver
 * related to given @p iface.
 *
 * @param iface
 * @param op
 * @return int
 * @retval 0 success
 * @retval -ENOENT driver interface not ready
 * @retval -ENOTSUP function not supported by driver
 */
static inline int dectnrp_driver_schedule(struct net_if *iface,
                                          struct dectnrp_driver_op *op) {
  const struct dectnrp_driver_api *driver = net_if_get_device(iface)->api;

  if (!driver) {
    return -ENOENT;
  } else if (driver->schedule == NULL) {
    return -ENOTSUP;
  } else {
    return driver->schedule(net_if_get_device(iface), op);
  }
}

/**
 * @brief Registers the given @p event_handler with the dectnrp_driver
 * related to given @p iface.
 *
 * @param iface
 * @param event_handler
 * @return int
 * @retval 0 success
 * @retval -ENOENT driver interface not ready
 * @retval -ENOTSUP function not supported by driver
 */
static inline int
dectnrp_driver_register_event_handler(struct net_if *iface,
                                      dectnrp_driver_event_cb_t event_handler) {
  const struct dectnrp_driver_api *driver = net_if_get_device(iface)->api;

  if (!driver) {
    return -ENOENT;
  } else if (driver->configure == NULL) {
    return -ENOTSUP;
  } else {
    const struct dectnrp_config config = {.event_handler = event_handler};
    return driver->configure(net_if_get_device(iface),
                             DECTNRP_CONFIG_TYPE_EVENT_HANDLER, &config);
  }
}

/**
 * @brief Start the dectnrp_driver related to given @p iface.
 *
 * @param iface
 * @return int
 * @retval 0 success
 * @retval -ENOENT driver interface not ready
 * @retval -ENOTSUP function not supported by driver
 */
static inline int dectnrp_driver_start(struct net_if *iface) {
  const struct dectnrp_driver_api *driver = net_if_get_device(iface)->api;

  if (!driver) {
    return -ENOENT;
  } else if (driver->start == NULL) {
    return -ENOTSUP;
  } else {
    return driver->start(net_if_get_device(iface));
  }
}

/**
 * @brief Stop the dectnrp_driver related to given @p iface.
 *
 * @param iface
 * @return int
 * @retval 0 success
 * @retval -ENOENT driver interface not ready
 * @retval -ENOTSUP function not supported by driver
 */
static inline int dectnrp_driver_stop(struct net_if *iface) {
  const struct dectnrp_driver_api *driver = net_if_get_device(iface)->api;

  if (!driver) {
    return -ENOENT;
  } else if (driver->stop == NULL) {
    return -ENOTSUP;
  } else {
    return driver->stop(net_if_get_device(iface));
  }
}

/**
 * @brief Activate/deactivate rx-filtering messages at the dectnrp_driver on
 * given @p iface for given receiver @p short_addr.
 *
 * @attention This only applies to packages of PHY TYPE 2! Packages are filtered
 * by the receiver identity encoded in the PHY TYPE 2 header. PHY TYPE 1
 * packages have not short address attached and are not be filtered!
 *
 * @param iface
 * @param short_addr Short receiver address used for filtering. If zero the
 * filter is switched off.
 * @return int
 * @retval 0 success
 * @retval -ENOENT driver interface not ready
 * @retval -ENOTSUP function not supported by driver
 */
static inline int
dectnrp_driver_filter_short_receiver_addr(struct net_if *iface,
                                          uint16_t short_addr) {
  const struct dectnrp_driver_api *driver = net_if_get_device(iface)->api;

  if (!driver) {
    return -ENOENT;
  } else if (driver->get_hw_capabilities == NULL || driver->configure == NULL) {
    return -ENOTSUP;
  } else if (driver->get_hw_capabilities(net_if_get_device(iface)) &
             DECTNRP_HW_FILTER) {

    const struct dectnrp_config config = {
        .filter_short_receiver_addr = {.activate = short_addr != 0x0,
                                       .value = short_addr}};
    return driver->configure(net_if_get_device(iface),
                             DECTNRP_CONFIG_TYPE_FILTER_SHORT_RECEIVER_ADDR,
                             &config);
  } else {
    return -ENOTSUP;
  }
}

/**
 * @brief Activate/deactivate rx-filtering messages at the dectnrp_driver on
 * given @p iface for given @p short_network_id.
 *
 * @param iface
 * @param short_network_id Short network id used for filtering. If zero the
 * filter is switched off.
 * @return int
 * @retval 0 success
 * @retval -ENOENT driver interface not ready
 * @retval -ENOTSUP function not supported by driver
 */
static inline int
dectnrp_driver_filter_short_network_id(struct net_if *iface,
                                       uint8_t short_network_id) {
  const struct dectnrp_driver_api *driver = net_if_get_device(iface)->api;

  if (!driver) {
    return -ENOENT;
  } else if (driver->get_hw_capabilities == NULL || driver->configure == NULL) {
    return -ENOTSUP;
  } else if (driver->get_hw_capabilities(net_if_get_device(iface)) &
             DECTNRP_HW_FILTER) {

    const struct dectnrp_config config = {
        .filter_short_network_id = {.activate = short_network_id != 0x0,
                                    .value = short_network_id}};
    return driver->configure(net_if_get_device(iface),
                             DECTNRP_CONFIG_TYPE_FILTER_SHORT_NETWORK_ID,
                             &config);
  } else {
    return -ENOTSUP;
  }
}

#endif /* __DECTNRP_DRIVER_UTILS_H__ */
```

## src/dectnrp_mac_helper.c
```c
/*
 * Copyright (c) 2026 Deveritec GmbH
 * SPDX-License-Identifier: Apache-2.0
 */

/**
 * @file
 * @brief DECTNRP helper providing access to a simplified test message and MAC
 * operations.
 *
 */

#include "dectnrp_mac_helper.h"

/**
 * @brief Test frame with one SDU containing User Flow 1 IE (and padding).
 *
 */
static uint8_t frame[] = {
    /* PHY header */
    0x10, /* Header format=0, packetlength-type=SLOTS, packet length=1 slot */
    0x78, /* Short Network ID */
    0xee, 0xff,       /* Transmitter ID (short id)*/
    0x71,             /* Transmit Power=7(0dBm), DF MCS=1 */
    0xff, 0xff,       /* Receiver Id */
    0x00, 0x00, 0x00, /* Feedback Format0 - no feedback */

    /* MAC header type */
    0x00, /* Data header, without security */
    /* MAC data header */
    0x00, 0x17, /* No reset, sequence number=0x17 */

    /* MAC mux header */
    0x43, 0xd, /* Medium SDU, User Flow 1 IE, 13 bytes payload */
    /* User Flow 1 IE + user payload Hello World!\n*/
    0x48, 0x65, 0x6c, 0x6c, 0x6f, 0x20, 0x57, 0x6f, 0x72, 0x6c, 0x64, 0x21,
    0x0a,

    /* MAC mux header */
    0x40, 0x11, /* Medium SDU, Padding IE, 17 bytes payload */
    /* Padding IE */
    0x00, 0x00, 0x00, 0x00, 0x00, 0x00, 0x00, 0x00, 0x00, 0x00, 0x00, 0x00,
    0x00, 0x00, 0x00, 0x00, 0x00

};

uint8_t *sample_frame = &frame[0];
const size_t sample_frame_size = sizeof(frame);
const uint8_t sample_frame_phy_header_type = 1;
const struct dectnrp_transport_parameters sample_frame_parameters = {
    .beta = 1,
    .mu = 1,
    .tbs = 37,
    .mcs = 1,
    .slots = 1,
};

void pcc_set_short_network_id(uint8_t *pcc, uint32_t network_id) {
  pcc[1] = network_id & 0xff;
}

void pcc_set_transmitter_short_id(uint8_t *pcc, uint16_t short_device_id) {
  UNALIGNED_PUT(sys_cpu_to_be16(short_device_id), (uint16_t *)(&pcc[2]));
}

void pcc_set_receiver_short_id(uint8_t *pcc, uint16_t short_device_id) {
  UNALIGNED_PUT(sys_cpu_to_be16(short_device_id), (uint16_t *)(&pcc[5]));
}

uint16_t pcc_decode_transmitter_short_id(const uint8_t *pcc, size_t len) {

  __ASSERT(len >= DECTNRP_PHY_HEADER_TYPE1_SIZE,
           "buffer len < DECTNRP_PHY_HEADER_TYPE1_SIZE");
  uint16_t raw = *(uint16_t *)(&pcc[2]);
  return sys_be16_to_cpu(raw);
}
```

## src/dectnrp_mac_helper.h
```c
/*
 * Copyright (c) 2026 Deveritec GmbH
 * SPDX-License-Identifier: Apache-2.0
 */

/**
 * @file
 * @brief DECTNRP helper providing access to a simplified test message and MAC operations.
 *
 */

#ifndef DECTNRP_MAC_HELPER_H_
#define DECTNRP_MAC_HELPER_H_

#include <stdint.h>
#include <stddef.h>
#include <zephyr/net/dectnrp_driver.h>

/**
 * @brief Pointer to the sample frame.
 */
extern uint8_t *sample_frame;

/**
 * @brief Size of sample_frame.
 */
extern const size_t sample_frame_size;

/**
 * @brief PHY header type of sample_frame.
 */
extern const uint8_t sample_frame_phy_header_type;

/**
 * @brief Transport parameters of sample_frame.
 */
extern const struct dectnrp_transport_parameters sample_frame_parameters;

/**
 * @brief Encode short part of given @p network_id into given @p pcc.
 * 
 * @param pcc 
 * @param network_id 
 */
void pcc_set_short_network_id(uint8_t* pcc, uint32_t network_id);

/**
 * @brief Encode short transmitter id from given @p short_device_id into given @p pcc.
 * 
 * @param pcc 
 * @param short_device_id 
 */
void pcc_set_transmitter_short_id(uint8_t* pcc, uint16_t short_device_id);

/**
 * @brief Encode short receiver id from given @p short_device_id into given @p pcc.
 * 
 * @param pcc 
 * @param short_device_id 
 */
void pcc_set_receiver_short_id(uint8_t* pcc, uint16_t short_device_id);

/**
 * @brief Decode short transmitter id from given \p pcc.
 * 
 * @attention Provided buffer @p pcc must have at least DECTNRP_PHY_HEADER_TYPE1_SIZE.
 * 
 * @param pcc pointer to buffer containing PCC.
 * @param len length of given @p pcc
 * @return uint16_t transmitter id
 */
uint16_t pcc_decode_transmitter_short_id(const uint8_t* pcc, size_t len);

#endif /* DECTNRP_MAC_HELPER_H_ */
```

## src/dectnrp_operation.c
```c
/*
 * Copyright (c) 2024 Deveritec GmbH.
 *
 * SPDX-License-Identifier: Apache-2.0
 */

/**
 * @file
 * @brief DECTNRP operations - operation management.
 *
 */

#include "dectnrp_operation.h"
#include <zephyr/kernel.h>
#include <zephyr/net/dectnrp_driver.h>

K_MEM_SLAB_DEFINE_STATIC(operations_slab, sizeof(struct dectnrp_driver_op), 10,
                         4);

/**
 * @brief Allocate a new operation and initialize basic fields common to all
 * operations.
 *
 * @param ctx
 * @return struct dectnrp_driver_op*
 */
static struct dectnrp_driver_op *
alloc_operation(enum dectnrp_driver_op_type type, struct net_if *iface,
                uint16_t channel) {

  struct dectnrp_driver_op *op = NULL;
  int ret = k_mem_slab_alloc(&operations_slab, (void **)&op, K_MSEC(10));
  if (ret == 0) {
    memset(op, 0, sizeof(struct dectnrp_driver_op));
    op->type = type;
    op->channel = channel;
  }
  return op;
}

int dectnrp_alloc_tx_operation(struct dectnrp_driver_op **new_op,
                               struct net_if *iface, uint16_t channel,
                               struct net_pkt *pkt) {
  struct dectnrp_driver_op *op =
      alloc_operation(DECTNRP_DRIVER_OP_TX, iface, channel);
  if (op) {
    op->tx.pkt = pkt;
    *new_op = op;
    return 0;
  } else {
    return -ENOMEM;
  }
}

int dectnrp_alloc_rx_operation(struct dectnrp_driver_op **new_op,
                               struct net_if *iface, uint16_t channel) {
  struct dectnrp_driver_op *op =
      alloc_operation(DECTNRP_DRIVER_OP_RX, iface, channel);
  if (op) {
    op->rx.expected_rssi = 0;
    *new_op = op;
    return 0;
  } else {
    return -ENOMEM;
  }
}

int dectnrp_alloc_rssi1_operation(struct dectnrp_driver_op **new_op,
                                  struct net_if *iface, uint16_t channel,
                                  net_time_t start_time, uint32_t subslots,
                                  struct dectnrp_rssi1_result *result) {

  struct dectnrp_driver_op *op =
      alloc_operation(DECTNRP_DRIVER_OP_RSSI1, iface, channel);
  if (op) {
    /* RSSI1 scans are expected to start on the scheduled frame boundary. */
    op->rssi1.mode.is_scheduled = (start_time != 0);
    op->start_time = start_time;
    op->rssi1.subslots = subslots;
    op->rssi1.result = result;
    memset(result->subslot, 0, sizeof(result->subslot));
    result->channel = channel;

    *new_op = op;
    return 0;
  } else {
    return -ENOMEM;
  }
}

void dectnrp_free_operation(struct dectnrp_driver_op *op) {
  __ASSERT(op != NULL, "op == NULL");

  if (op->type == DECTNRP_DRIVER_OP_TX) {
    net_pkt_unref(op->tx.pkt);
    op->tx.pkt = NULL;
  }
  k_mem_slab_free(&operations_slab, (void *)op);
}
```

## src/dectnrp_operation.h
```c
/*
 * Copyright (c) 2026 Deveritec GmbH
 * SPDX-License-Identifier: Apache-2.0
 */

/**
 * @file
 * @brief DECTNRP operations - interface for operation management.
 *
 */

#include <zephyr/net/dectnrp_driver.h>

/**
 * @brief Allocate a new tx operation \p op and preset its values.
 *
 * @param[out] op Return value for preseted transmit operation.
 * @param ctx Context related to interface the operation shall be executed on.
 * @param pkt
 * @return int -ENOMEM if there is no memory left to allocate memory for the new
 * op.
 * @return int 0 if no error occured.
 */
int dectnrp_alloc_tx_operation(struct dectnrp_driver_op **new_op,
                               struct net_if *iface, uint16_t channel,
                               struct net_pkt *pkt);

/**
 * @brief Allocate a new rx operation \p op and preset its values.
 *
 * @param[out] op Return value for preseted receive operation.
 * @return int -ENOMEM if there is no memory left to allocate memory for the new
 * op.
 * @return int 0 if no error occured.
 */
int dectnrp_alloc_rx_operation(struct dectnrp_driver_op **op,
                               struct net_if *iface, uint16_t channel);

/**
 * @brief Allocate a new rssi1 operation \p op and preset its values.
 *
 * @param[out] op Return value for preseted rssi operation.
 * @param ctx Context related to interface the operation shall be executed on.
 * @param start_time Time of scan chart in modem ticks
 * @param subslots Duration of the rssi1 operation in number of subslots.
 * @param channel Channel number the scan shall observe.
 * @param result_buf pointer to rssi1 measurement buffer
 * @return int -ENOMEM if there is no memory left to allocate memory for the new
 * op.
 * @return int 0 if no error occured.
 */
int dectnrp_alloc_rssi1_operation(struct dectnrp_driver_op **new_op,
                                  struct net_if *iface, uint16_t channel,
                                  net_time_t start_time, uint32_t subslots,
                                  struct dectnrp_rssi1_result *result);

/**
 * @brief Free the given operation \p op.
 *
 * @param op Operation to free the memory of.
 */
void dectnrp_free_operation(struct dectnrp_driver_op *op);
```
