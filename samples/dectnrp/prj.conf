## Kconfig
```
# Copyright (c) 2026 Deveritec GmbH
# SPDX-License-Identifier: Apache-2.0

module = SAMPLE_DECTNRP
module-str = Opener DECT NR+ sample
source "$(ZEPHYR_BASE)/subsys/logging/Kconfig.template.log_config"

menu "Zephyr Kernel"
source "Kconfig.zephyr"
endmenu
```

## sample.yaml
```
sample:
  name: dectnrp
  description: Demo of the dectnrp l2
tests:
  sample.driver_api:
    platform_allow:
      - nrf9151dk/nrf9151/ns
```

## prj.conf
```kconfig
# Copyright (c) 2026 Deveritec GmbH
# SPDX-License-Identifier: Apache-2.0

CONFIG_KERNEL_BIN_NAME="sample-dectnrp"
CONFIG_NCS_APPLICATION_BOOT_BANNER_STRING="sample-dectnrp"

#Enable thread awareness for debugging tools supporting it
CONFIG_DEBUG_THREAD_INFO=y
CONFIG_ASSERT=y

CONFIG_TFM_PROFILE_TYPE_MINIMAL=y

# Kernel options
CONFIG_HEAP_MEM_POOL_SIZE=2048

CONFIG_HWINFO=y
CONFIG_LOG=y
CONFIG_USE_SEGGER_RTT=y
CONFIG_LOG_BACKEND_RTT=y
CONFIG_SEGGER_RTT_BUFFER_SIZE_UP=4096
CONFIG_LOG_BACKEND_RTT_MODE_OVERWRITE=y

CONFIG_DECTNRP_DRIVER_NRF91X1=y
CONFIG_DECTNRP_DRIVER_NRF91X1_CAP_LOGGING=n
CONFIG_DECTNRP_DRIVER_SCHEDULED_API=y
CONFIG_DECTNRP_DRIVER_BLOCKING_API=n

CONFIG_SAMPLE_DECTNRP_LOG_LEVEL_DBG=n
CONFIG_SAMPLE_DECTNRP_LOG_LEVEL_INF=y

# Generic networking options
CONFIG_NETWORKING=y
CONFIG_NET_LOG=y

# DECTNRP L2 layer settings
CONFIG_NET_L2_DECTNRP=y
CONFIG_NET_L2_DECTNRP_LOG_LEVEL_ERR=n
CONFIG_NET_L2_DECTNRP_LOG_LEVEL_WRN=n
CONFIG_NET_L2_DECTNRP_LOG_LEVEL_INF=n
CONFIG_NET_L2_DECTNRP_LOG_LEVEL_DBG=y
```

## src/main.c
```c
/*
 * Copyright (c) 2026 Deveritec GmbH
 * SPDX-License-Identifier: Apache-2.0
 */

#include <zephyr/logging/log.h>
LOG_MODULE_REGISTER(dectnrp_sample, CONFIG_SAMPLE_DECTNRP_LOG_LEVEL);

#include <opener/build_info.h>
#include <zephyr/drivers/hwinfo.h>
#include <zephyr/kernel.h>
#include <zephyr/net/dectnrp_net_l2.h>
#include <zephyr/net/net_if.h>

int main()
{
	LOG_DBG("Opener version %d.%d.%d-%s%c", OPENER_VERSION_MAJOR, OPENER_VERSION_MINOR,
		OPENER_PATCHLEVEL, STRINGIFY(OPENER_GIT_COMMIT), OPENER_DIRTY ? '+' : '=');

	LOG_DBG("Opener dectnrp driver sample started");

	/* Get the DECT network interface */
	struct net_if *iface = net_if_get_first_by_type(&NET_L2_GET_NAME(DECTNRP));
	if (!iface) {
		LOG_ERR("net_if_get_first_by_type failed");
		return -ENODEV;
	} else if (!net_if_is_up(iface)) {
		LOG_ERR("net_if_is_up failed");
		return -ENOENT;

	} else {

		do {

			k_sleep(K_MSEC(1000));
			LOG_ERR("ping");

		} while (true);
	}

	return 0;
}
```
